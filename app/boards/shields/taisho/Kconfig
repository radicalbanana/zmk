## app/boards/shields/taisho/Kconfig
```kconfig
# Kconfig

config SHIELD_TAISHO
    def_bool $(shields_has_keyboard_overlay)

config ZMK_KEYBOARD_NAME_FULL
    default "Taisho"

CONFIG_ZMK_BLE=y
CONFIG_ZMK_KSCAN_MATRIX_DIRECT=y

CONFIG_ZMK_KSCAN_MATRIX_ROWS=1
CONFIG_ZMK_KSCAN_MATRIX_COLS=26
```
